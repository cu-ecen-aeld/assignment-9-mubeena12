## base_external/package/ldd/Config.in
```kconfig
config BR2_PACKAGE_LDD
	bool "ldd"
	help
	  LDD module
	  Includes the LDD module with misc-modules and scull drivers in the kernel image.
	  Used to understand kernel driver builds.
```
